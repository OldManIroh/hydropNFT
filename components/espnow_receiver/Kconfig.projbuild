## components/espnow_receiver/Kconfig.projbuild
```kconfig
menu "Настройки ESP-NOW"

    config ESPNOW_CHANNEL
        int "Wi-Fi канал ESP-NOW"
        default 10
        range 1 14
        help
            Wi-Fi канал для связи ESP-NOW.
            Должен совпадать с каналом передатчика и Wi-Fi роутера.
            ESP32 не может работать на разных каналах одновременно.

    config ESPNOW_PMK
        string "Ключ PMK"
        default "pmk12345567890123"
        help
            Ключ шифрования ESP-NOW (Primary Master Key).
            Должен совпадать с ключом передатчика. Длина — 16 байт.

endmenu
```

## components/mqtt_client/Kconfig.projbuild
```kconfig
menu "Настройки MQTT"

    config MQTT_BROKER_URI
        string "URI брокера"
        default "mqtt://192.168.0.107:1883"
        help
            Адрес MQTT брокера для подключения.
            Примеры: mqtt://192.168.0.107:1883, mqtts://broker.example.com:8883

    config MQTT_USERNAME
        string "Имя пользователя"
        default "hydroesp32"
        help
            Имя пользователя для аутентификации на MQTT брокере.

    config MQTT_PASSWORD
        string "Пароль"
        default "asda"
        help
            Пароль для аутентификации на MQTT брокере.
            Внимание: хранится в открытом виде в конфигурации.

    config LIGHT_ON_HOUR
        int "Час включения света"
        default 8
        range 0 23
        help
            Час (0–23), в который включается свет по расписанию.

endmenu
```

## components/ota_client/Kconfig.projbuild
```kconfig
menu "Настройки OTA обновления"

    config EXAMPLE_FIRMWARE_UPG_URL
        string "URL прошивки"
        default "https://example.com/firmware.bin"
        help
            HTTPS URL для загрузки новой прошивки.

    config EXAMPLE_OTA_RECV_TIMEOUT
        int "Таймаут получения данных (мс)"
        default 60000
        help
            Таймаут получения данных OTA в миллисекундах.
            Увеличьте при медленном Wi-Fi соединении.

    config EXAMPLE_GPIO_DIAGNOSTIC
        int "GPIO пин диагностики"
        default 34
        help
            GPIO пин для проверки работоспособности после OTA обновления.

            Внимание: не используйте GPIO 0 (кнопка BOOT) или GPIO 2 (встроенный LED).
            Рекомендуемые пины: GPIO 34, 35, 36, 39 — только вход, без внутренних подтяжек.
            По умолчанию GPIO 34.

endmenu
```

## components/sntp_client/Kconfig.projbuild
```kconfig
menu "Настройки SNTP (времени)"

    choice SNTP_SERVER_COUNT
        prompt "Количество NTP серверов"
        default SNTP_SERVER_COUNT_4
        help
            Число NTP серверов для отказоустойчивости.

            Примечание: также увеличьте CONFIG_LWIP_SNTP_MAX_SERVERS (по умолч.: 1):
            menuconfig → Component config → LWIP → SNTP → Max SNTP servers

        config SNTP_SERVER_COUNT_1
            bool "1 сервер"
        config SNTP_SERVER_COUNT_2
            bool "2 сервера"
        config SNTP_SERVER_COUNT_3
            bool "3 сервера"
        config SNTP_SERVER_COUNT_4
            bool "4 сервера"
    endchoice

    config SNTP_SERVER_1
        string "Основной NTP сервер"
        default "ntp.msk-ix.ru"
        help
            Основной сервер для синхронизации времени.

    config SNTP_SERVER_2
        string "Резервный NTP сервер"
        default "ru.pool.ntp.org"
        help
            Первый резервный сервер.

    config SNTP_SERVER_3
        string "Второй резервный NTP сервер"
        default "pool.ntp.org"
        help
            Второй резервный сервер.

    config SNTP_SERVER_4
        string "Третий резервный NTP сервер"
        default "time.google.com"
        help
            Третий резервный сервер.

    config SNTP_SYNC_RETRY_COUNT
        int "Количество попыток синхронизации"
        default 30
        help
            Число попыток синхронизации SNTP перед отказом.

    config SNTP_TIMEZONE
        string "Часовой пояс (POSIX TZ string)"
        default "MSK-5"
        help
            Строка часового пояса в формате POSIX TZ.
            Примеры:
              MSK-5    — UTC+5 (Екатеринбург)
              MSK-3    — UTC+3 (Москва)
              UTC0     — UTC
              CST-8    — UTC+8 (Китай)
              EST5EDT  — Восточное время США с DST

endmenu
```

## components/web_server/Kconfig.projbuild
```kconfig
menu "Настройки веб-сервера"

    config WEB_SERVER_ENABLED
        bool "Включить веб-сервер"
        default y
        help
            Включить встроенный HTTP сервер для локального управления.

    config WEB_SERVER_PORT
        int "Порт веб-сервера"
        default 80
        range 1 65535
        help
            TCP порт для HTTP сервера.

endmenu
```

## main/Kconfig.projbuild
```kconfig
menu "Настройки оборудования"

    config PUMP_GPIO
        int "GPIO пин насоса"
        default 19
        help
            Номер GPIO пина для управления насосом.

    config LIGHT_GPIO
        int "GPIO пин света"
        default 18
        help
            Номер GPIO пина для управления светом (фитолампа).

    config VALVE_GPIO
        int "GPIO пин клапана"
        default 4
        help
            Номер GPIO пина для управления клапаном.

    config VALVE_DRAIN_DURATION_MIN
        int "Время слива воды (минуты)"
        default 5
        range 1 30
        help
            Длительность слива воды через клапан в минутах.
            Используется в автоматическом режиме DRAINING.

endmenu

menu "Настройки датчика DHT"

    choice EXAMPLE_CHIP_TYPE
        prompt "Тип датчика"
        default EXAMPLE_TYPE_AM2301

        config EXAMPLE_TYPE_DHT11
            bool "DHT11"
        config EXAMPLE_TYPE_AM2301
            bool "DHT21 / DHT22 / AM2301 / AM2302 / AM2321"
        config EXAMPLE_TYPE_SI7021
            bool "Itead Si7021"
    endchoice

    config EXAMPLE_DATA_GPIO
        int "GPIO пин данных"
        default 4 if IDF_TARGET_ESP8266
        default 4 if IDF_TARGET_ESP32C2 || IDF_TARGET_ESP32C3 || IDF_TARGET_ESP32C5 || IDF_TARGET_ESP32C6 || IDF_TARGET_ESP32C61
        default 4 if IDF_TARGET_ESP32H2
        default 4 if IDF_TARGET_ESP32P4
        default 17 if IDF_TARGET_ESP32 || IDF_TARGET_ESP32S2 || IDF_TARGET_ESP32S3
        help
            Номер GPIO пина, подключённого к выводу DATA датчика.

    config EXAMPLE_INTERNAL_PULLUP
        bool "Внутренний pull-up резистор"
        default n
        help
            Включите, если на пине данных нет внешнего pull-up резистора.
            Датчики DHT на печатной плате обычно имеют встроенный pull-up.
            Для стабильной работы рекомендуется внешний резистор 10 кОм.

endmenu

menu "Настройки точки доступа (AP)"

    config AP_WIFI_PASSWORD
        string "Пароль точки доступа"
        default "hydronft12345678"
        help
            Пароль WPA2 для точки доступа HydroNFT_XXYY.
            Минимум 8 символов. Используется для защиты
            веб-интерфейса при подключении напрямую к устройству.

endmenu
```
